## drivers/misc/samsung/Kconfig
```kconfig
config DRV_SAMSUNG
	bool "samsung device dedicated drivers option"
	default n
	help
	  This is driver option for samsung sec_class
	  Say y here to enable samsung classes for drivers
	  Provide option of enabling sec class
```
