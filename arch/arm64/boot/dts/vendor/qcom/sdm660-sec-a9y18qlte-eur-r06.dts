// SPDX-License-Identifier: GPL-2.0-only
/*
 * Samsung Galaxy A9 (2018), SM-A920F, EUR board revision 06.
 */

/dts-v1/;

#include "sdm660.dtsi"
#include "sdm660-mtp.dtsi"
#include "msm-pm660a.dtsi"
#include "sdm660-internal-codec.dtsi"
#include "samsung/sdm660-sec-a9y18qlte-common.dtsi"

/ {
	model = "Samsung A9Y18QLTE EUR PROJECT Rev06 (board-id,06)";
	compatible = "qcom,sdm660-mtp", "qcom,sdm660", "qcom,mtp";
	/* The bootloader picks the DTB by msm-id and this board-id */
	qcom,board-id = <8 6>;
};
